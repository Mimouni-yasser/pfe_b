## boards/arm/smart_box/Kconfig.board
```kconfig
# Copyright (c) 2024 Nordic Semiconductor ASA
# SPDX-License-Identifier: Apache-2.0

config BOARD_SMART_BOX
	bool "smart box"
	depends on SOC_NRF52840_QFAA
```

## boards/arm/smart_box/Kconfig.defconfig
```kconfig
# Copyright (c) 2024 Nordic Semiconductor ASA
# SPDX-License-Identifier: Apache-2.0

if BOARD_SMART_BOX

config BOARD
	default "smart_box"

config BT_CTLR
   default BT


endif
```
